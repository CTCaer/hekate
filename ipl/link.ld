ENTRY(_start)

SECTIONS {
	PROVIDE(__ipl_start = 0x40003000);
	. = __ipl_start;
	.text : {
		*(.text*);
	}
	.data : {
		*(.data*);
		*(.rodata*);
	}
	. = ALIGN(0x10);
	__ipl_end = .;
	.bss : {
		__bss_start = .;
		*(COMMON)
		*(.bss*)
		__bss_end = .;
	}
}
